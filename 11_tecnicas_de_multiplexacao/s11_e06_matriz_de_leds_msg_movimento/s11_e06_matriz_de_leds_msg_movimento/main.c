/*
 * s11_e06_matriz_de_leds_msg_movimento.c
 *
 * Created: 24/01/2023 15:45:44
 * Author : Matheus
 *
 * 11.5 – Na fig. 11.18, é apresentado um sistema para o controle de uma matriz com
 * 192 LEDs (8 × 24). O sistema alimenta uma linha por vez. Os dados correspondentes
 * a cada coluna, incluindo qual linha será alimentada, são fornecidos por um
 * conjunto de registradores de deslocamento (shift register – 74HC594, conversor
 * serial-paralelo). Para controlar todo o sistema são empregadas 3 saídas do
 * microcontrolador.
 * - Como o programa pode apresentar mensagens em movimento? Neste caso o pino de
 * limpeza dos registradores (MR) teria um papel importante?
 *   - gerador de vetores para uma matriz de leds 8x8: https://xantorohara.github.io/led-matrix-editor/
 */ 

#include "definicoes_principais.h" //inclui a biblioteca de definições principais


//definições de hardware
#define CLK PB0 //define o pino de clock
#define D   PB1 //define o pino de saída de dados seriais
#define STB PB2 //define o pino de strobe
#define CLR PB3 //define o pino de limpeza do registrador

//definições de macors
#define pulso_clock() set_bit(PORTB, CLK); _delay_us(10); clr_bit(PORTB, CLK)
#define pulso_strobe() set_bit(PORTB, STB); _delay_us(10); clr_bit(PORTB, STB)
#define pulso_clear() clr_bit(PORTB, CLR); _delay_us(10); set_bit(PORTB, CLR)

//declaração de letras
const char _tabela_ASCII[][8] PROGMEM =
{
	{0b00000000, 0b00000000, 0b00000000, 0b00000000, 0b00000000, 0b00000000, 0b00000000, 0b00000000}, //' '(espaço)
	{0b00011000, 0b00111100, 0b00111100, 0b00011000, 0b00011000, 0b00000000, 0b00011000, 0b00000000}, //'!'
	{0b00110110, 0b00110110, 0b00110110, 0b00000000, 0b00000000, 0b00000000, 0b00000000, 0b00000000}, //'"'
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	{0b01110110, 0b11011100, 0b00000000, 0b00000000, 0b00000000, 0b00000000, 0b00000000, 0b00000000}  //'~'
};

//acionamento dos transistores
const char _aciona_linhas[] PROGMEM =
{
	0x80, //aciona linha 0
	0x40, //aciona linha 1
	0x20, //aciona linha 2
	0x10, //aciona linha 3
	0x08, //aciona linha 4
	0x04, //aciona linha 5
	0x02, //aciona linha 6
	0x01  //aciona linha 7
};

void serial_paralelo(char byte);       //declaração de função para conversão de um dado serial para paralelo
void escreve_mensagem(char *mensagem); //declaração de função para escrever uma mensagem em três matrizes de led

int main() //função principal
{
	DDRB = 0xFF;  //configura todo o PORTB como saída
	PORTB = 0x00; //inicializa todo o PORTB em nível baixo

	while(1) //loop infinito
	{
		//escreve_mensagem("AVR - ATmega328p");
		//escreve_mensagem("Matriz de leds - 8 x 24");
		escreve_mensagem("{[(^~)]}");
	}
}

void serial_paralelo(char byte) //implementação de função para conversão de um dado serial para paralelo
{
	unsigned char bit = 8;                        //declaração de variável auxiliar
	do
	{
		bit--;                                    //decrementa a variável auxiliar
		if(tst_bit(byte, bit)) clr_bit(PORTB, D); //seta o bit - o 74HC595 drena a corrente, assim, liga o led
		else                   set_bit(PORTB, D); //limpa o bit- o 74HC595 bloqueia a corrente, assim, desliga o led
		pulso_clock();                            //pulso de clock
	}while(bit != 0);                             //envia oito bits de dados
}

void escreve_mensagem(char *mensagem) //implementação de função para escrever uma mensagem em três matrizes de led
{
	while(*(mensagem + 2))                                      //enquanto for possivel exibir 3 caracteres...
	{
		for(unsigned char tempo = 0; tempo < 15; tempo++)               //exibe a mesma mensagem por um segundo
		{
			pulso_clear();                                              //limpa os pinos de todos os 74HC595(~10us)
			for(unsigned char linha = 0; linha < 8; linha++)            //varredura das linhas
			{
				for(unsigned char coluna = 0; coluna < 3; coluna++)     //varredura das colunas
				    serial_paralelo(pgm_read_byte(&_tabela_ASCII[*(mensagem + coluna) - 32][linha]));
				serial_paralelo(pgm_read_byte(&_aciona_linhas[linha])); //acionamento da linha
				pulso_strobe();                                         //atualiza as saídas dos SR(~10us)
				_delay_ms(2);                                           //atraso de persistência da visão(2ms)
			}
		}
		mensagem++;                                                     //próximo caractere da mensagem
    }
}
